## config/west.yml
```yaml
manifest:
  remotes:
    - name: caksoylar
      url-base: https://github.com/caksoylar
  projects:
    - name: zmk-tri-state
      remote: caksoylar
      revision: main
      import: app/west.yml
  self:
    path: config
```
